## src/kernel/bp-v5.15.8/drivers/net/wireless/celeno/Kconfig
```kconfig
# SPDX-License-Identifier: GPL-2.0 OR BSD-2-Clause
config WLAN_VENDOR_CELENO
	bool "Celeno devices"
	default y
	help
	  If you have a wireless card belonging to this class, say Y.

	  Note that the answer to this question doesn't directly affect the
	  kernel: saying N will just cause the configurator to skip all the
	  questions about these cards. If you say Y, you will be asked for
	  your specific card in the following questions.

if WLAN_VENDOR_CELENO

source "drivers/net/wireless/celeno/cl6k/Kconfig"
source "drivers/net/wireless/celeno/cl_core/Kconfig"

endif # WLAN_VENDOR_CELENO
```

## src/kernel/bp-v5.15.8/drivers/net/wireless/celeno/cl6k/Kconfig
```kconfig
# SPDX-License-Identifier: GPL-2.0 OR BSD-2-Clause
config CL6K
	tristate "Celeno CL6K WLAN support"
	depends on m
	depends on MAC80211
	help
	  This option enables support for Celeno CL6K WLAN.
	  Select M (recommended), if you have a wireless module.
```

## src/kernel/bp-v5.15.8/drivers/net/wireless/celeno/cl_core/Kconfig
```kconfig
# SPDX-License-Identifier: GPL-2.0 OR BSD-2-Clause
config CL6K
	tristate "Celeno CL CLI USB support"
	depends on m
	depends on USB
	help
	  This option enables support for Celeno CL CLI USB.
	  Select M (recommended), if you have a wireless USB module.
```
